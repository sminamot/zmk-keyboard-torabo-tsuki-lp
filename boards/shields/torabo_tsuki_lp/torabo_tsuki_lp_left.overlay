#include "torabo_tsuki_lp.dtsi"
#include <input/processors.dtsi>
#include <dt-bindings/zmk/input_transform.h>

&zip_temp_layer {
    excluded-positions = <19 20 21>;
};

&pointing_listener {
    input-processors = <
        &zip_xy_transform (INPUT_TRANSFORM_X_INVERT | INPUT_TRANSFORM_Y_INVERT)
        &zip_temp_layer 1 1000
    >;

    scroller {
        layers = <2>;
        input-processors = <
            &torabo_vertical_scroll_mapper
            &zip_scroll_scaler 1 10
        >;
    };
};
